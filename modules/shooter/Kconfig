## modules/shooter/Kconfig
```kconfig
# Copyright (c) 2026 RobotPilots-SZU
# SPDX-License-Identifier: Apache-2.0

config BREEZE_MODULE_SHOOTER
	bool "Shooter module"
	depends on CPP
	depends on RAMENX
	depends on ALGO
	help
	  Shooter module (friction wheel + feeder) built on ramen actors.
```
