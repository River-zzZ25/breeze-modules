## Kconfig
```kconfig
# Copyright (c) 2025 RobotPilots-SZU
# SPDX-License-Identifier: Apache-2.0

config ZEPHYR_BREEZE_MODULES_MODULE
	bool

menuconfig BREEZE_MODULES
	bool "Breeze application modules"
	help
	  Robot application modules (chassis, gimbal, ...) that communicate over
	  zenoh topics and use the breeze-middleware protocol and OSAL.

if BREEZE_MODULES

rsource "modules/chassis/Kconfig"
rsource "modules/referee/Kconfig"
rsource "modules/msgpipe/Kconfig"
# rsource "modules/gimbal/Kconfig"
# rsource "modules/shooter/Kconfig"

endif # BREEZE_MODULES
```

## modules/chassis/Kconfig
```kconfig
# Copyright (c) 2025 RobotPilots-SZU
# SPDX-License-Identifier: Apache-2.0

config BREEZE_MODULE_CHASSIS
	bool "Chassis module"
	depends on MIDDLEWARE_PROTOCOL
	depends on MIDDLEWARE_OSAL
	help
	  Chassis control module. Consumes chassis command topics, drives the
	  chassis motors, and publishes chassis state.

if BREEZE_MODULE_CHASSIS

module = BREEZE_MODULE_CHASSIS
module-str = breeze chassis
source "subsys/logging/Kconfig.template.log_config"

endif # BREEZE_MODULE_CHASSIS
```

## modules/communicator/Kconfig
```kconfig
# Copyright (c) 2026 RobotPilots-SZU
# SPDX-License-Identifier: Apache-2.0

config BREEZE_MODULE_COMMUNICATOR
	bool "Communicator module"
	depends on CPP
	depends on ALGO
	depends on NANOPB
	help
	  Parses vt / inter-robot / vision protocol streams and exposes typed dataflow ports.
```

## modules/gimbal/Kconfig
```kconfig
# Copyright (c) 2026 RobotPilots-SZU
# SPDX-License-Identifier: Apache-2.0

config BREEZE_MODULE_GIMBAL
	bool "Gimbal module"
	depends on CPP
	depends on ALGO
	help
	  Gimbal Control Module. Provides Height-Axis, Yaw-Axis, Pitch-Axis Control.
```

## modules/msgpipe/Kconfig
```kconfig
# Copyright (c) 2026 RobotPilots-SZU
# SPDX-License-Identifier: Apache-2.0

config BREEZE_MODULE_MSGPIPE
	bool "message pipe wrapper and conventions (based on zbus)"
	depends on CPP
	select ZBUS
	help
	  Wrap zbus on cpp strong-typed and user-friendly functions
```

## modules/referee/Kconfig
```kconfig
# Copyright (c) 2026 RobotPilots-SZU
# SPDX-License-Identifier: Apache-2.0

config BREEZE_MODULE_REFEREE
	bool "Referee module"
	depends on CPP
	depends on ALGO
	help
	  Parses referee protocol streams and exposes typed dataflow ports.

if BREEZE_MODULE_REFEREE

config BREEZE_MODULE_REFEREE_RING_BUF_SIZE
	int "Referee Module ring buffer size (bytes)"
	default 1024
	range 320 2048
	help
	  Size of the ring buffer used by the referee module, in bytes.
	  Must be a power-of-two-friendly value for the underlying
	  ring buffer implementation.

config BREEZE_MODULE_REFEREE_LINEAR_BUF_SIZE
	int "Referee Module linear buffer size (bytes)"
	default 512
	range 320 1024
	help
	  Size of the linear scratch buffer used to inspect referee frames, in bytes.

endif # BREEZE_MODULE_REFEREE
```

## west.yml
```yaml
manifest:
  self:
    path: .
    import:
      file: dependencies.yml
      path-prefix: zephyr-extras
```
